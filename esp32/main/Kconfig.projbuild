## esp32/main/Kconfig.projbuild
```kconfig
menu "Digits development configuration"
    config DIGITS_WIFI_SSID
        string "Wi-Fi SSID (fallback)"
        default ""
        help
            Used only until a network is saved from the setup page or the
            console ('wifi set'). Empty: the phone opens its setup network.
    config DIGITS_WIFI_PASSWORD
        string "Wi-Fi password (fallback)"
        default ""
    config DIGITS_WIFI_SETUP_AFTER_S
        int "Open the setup network after this long without Wi-Fi or server (seconds)"
        range 30 3600
        default 120
        help
            The phone keeps retrying while the setup network is open and
            closes it once everything works again. Long enough for a
            router that restarts after a power cut.
    config DIGITS_SETUP_PASSWORD
        string "Setup network password (8-63 characters)"
        default ""
        help
            WPA2 password of Digits-Setup-XXXX, which guards the setup page
            (Wi-Fi, server, firmware upload, restart). The same on every
            phone built with it. Empty leaves the network open: anyone
            nearby could then reconfigure or reflash the phone while it is
            in setup.
    config DIGITS_SETUP_FORCED_MINUTES
        int "Setup network on request stays open (minutes)"
        range 5 240
        default 30
        help
            After a long button press, the server's recovery command or
            'wifi setup', while the phone is otherwise working.
    config DIGITS_SERVER_URL
        string "Digits WebSocket URL (fallback, ws://host:port/ws)"
        default ""
        help
            Used only until a server is saved from the setup page or the
            console ('wifi server').
    menu "WebRTC interoperability"
        config DIGITS_WEBRTC
            bool "Enable one-to-one WebRTC interoperability"
            depends on MBEDTLS_TLS_ENABLED
            default y
            select MBEDTLS_SSL_PROTO_TLS1_2
            select MBEDTLS_SSL_PROTO_DTLS
            select MBEDTLS_SSL_DTLS_SRTP
            help
                Development milestone for the unchanged Digits protocol and an
                existing Pion client. One IPv4 UDP host/STUN peer is supported;
                TURN, group calls and ICE restart are not implemented. Media
                uses live 48 kHz mono microphone Opus and bounded decoded
                speaker playback. Dedicated audio tasks keep I2S and codec
                work out of signaling and peer callbacks. Full-duplex calls
                reserve audio devices against Ring Test and recording tests.
        config DIGITS_WEBRTC_CONSOLE
            bool "Enable development WebRTC commands on USB Serial/JTAG"
            depends on DIGITS_WEBRTC && ESP_CONSOLE_USB_SERIAL_JTAG
            default y
            help
                Enable the commands webrtc call NUMBER, webrtc answer,
                webrtc hangup and webrtc status in idf.py monitor. Commands
                enqueue operations without blocking signaling. Only eight
                commands are kept in RAM history; no credentials are exposed.
        config DIGITS_WEBRTC_AUTO_ANSWER
            bool "Automatically accept incoming one-to-one calls for testing"
            depends on DIGITS_WEBRTC
            default n
            help
                Lab-only shortcut for interoperability testing. Otherwise an
                incoming call waits for webrtc answer or webrtc hangup. This
                call can transmit live microphone audio and play received
                audio through the integrated speaker.
    endmenu
    menu "Phone controls"
        depends on DIGITS_WEBRTC
        config DIGITS_PHONE
            bool "Enable hook switch and call buttons"
            default y
            help
                Lifting the handset during an incoming call answers it,
                replacing it ends any call, and with the handset lifted
                call button A or B dials its configured number. The
                incoming ringtone is suppressed while the handset is lifted.
                Console: phone status, phone set a|b NUMBER, phone clear a|b,
                phone hook up|down and phone press a|b for testing.
        choice DIGITS_PHONE_INPUTS
            prompt "Input hardware"
            depends on DIGITS_PHONE
            default DIGITS_PHONE_INPUT_BOARD_KEYS
            config DIGITS_PHONE_INPUT_BOARD_KEYS
                bool "Waveshare board keys (KEY1 toggles hook, KEY2 calls A, KEY3 calls B)"
                depends on !DIGITS_MIC_BUTTON_RECORD_PLAYBACK
                help
                    Development mapping on TCA9555 P11-P13. KEY1 is a
                    momentary key, so each press lifts or replaces the
                    simulated handset. Unavailable while the KEY1
                    hold-to-record diagnostic is selected.
            config DIGITS_PHONE_INPUT_GPIO
                bool "Direct GPIO hook switch and call buttons"
                help
                    Hook switch and buttons on ESP32-S3 GPIOs with internal
                    pull-ups. Buttons connect the GPIO to ground when pressed.
        endchoice
        config DIGITS_PHONE_HOOK_GPIO
            int "Hook switch GPIO"
            depends on DIGITS_PHONE_INPUT_GPIO
            range 0 48
            default 4
        config DIGITS_PHONE_HOOK_OFF_HOOK_LOW
            bool "Hook switch input reads low while the handset is lifted"
            depends on DIGITS_PHONE_INPUT_GPIO
            default y
        config DIGITS_PHONE_CALL_A_GPIO
            int "Call button A GPIO"
            depends on DIGITS_PHONE_INPUT_GPIO
            range 0 48
            default 5
        config DIGITS_PHONE_CALL_B_GPIO
            int "Call button B GPIO"
            depends on DIGITS_PHONE_INPUT_GPIO
            range 0 48
            default 6
        config DIGITS_PHONE_CALL_C_GPIO
            int "Call button C GPIO"
            depends on DIGITS_PHONE_INPUT_GPIO
            range 0 48
            default 39
            help
                Board-key mode has no third key; button C exists only here.
        config DIGITS_PHONE_CALL_A_NUMBER
            string "Default number for call button A"
            depends on DIGITS_PHONE
            default ""
            help
                Used until 'phone set a NUMBER' stores a per-device number in
                NVS. Each phone calls different participants, so prefer the
                console setting and keep one firmware image for all phones.
        config DIGITS_PHONE_CALL_B_NUMBER
            string "Default number for call button B"
            depends on DIGITS_PHONE
            default ""
        config DIGITS_PHONE_CALL_C_NUMBER
            string "Default number for call button C"
            depends on DIGITS_PHONE
            default ""
        config DIGITS_PHONE_SELECTOR_POSITIONS
            int "Ringtone selector positions"
            depends on DIGITS_PHONE
            range 2 12
            default 12
            help
                Positions of each local ringtone selector (rotary switch or
                fader). Each position maps to a ringtone with
                'phone position N RINGTONE'.
        config DIGITS_PHONE_SELECTOR_A_GPIO
            int "Ringtone selector A analog GPIO (-1: set from the console)"
            depends on DIGITS_PHONE
            range -1 9
            default -1
            help
                ADC1 pin (GPIO1-9; GPIO10 is the board I2C clock) wired to a resistor ladder or fader for
                calls from button A's number. -1 keeps the position set with
                'phone selector a N'. Avoid GPIO3 (strapping).
        config DIGITS_PHONE_SELECTOR_B_GPIO
            int "Ringtone selector B analog GPIO (-1: set from the console)"
            depends on DIGITS_PHONE
            range -1 9
            default -1
        config DIGITS_PHONE_SELECTOR_C_GPIO
            int "Ringtone selector C analog GPIO (-1: set from the console)"
            depends on DIGITS_PHONE
            range -1 9
            default -1
        config DIGITS_SD_RINGTONES
            bool "Ringtones from the SD card"
            depends on DIGITS_PHONE
            default y
            help
                Plays ringtones/ringtone-NN.mp3 from the board's SD card,
                streamed while ringing: selector position NN then plays that
                file instead of its mapped ringtone. The card uses
                GPIO40-42; keep buttons off those pins.
        config DIGITS_SD_RINGTONE_LEVEL
            int "SD card ringtone level (percent of the file's level)"
            depends on DIGITS_SD_RINGTONES
            range 1 100
            default 12
            help
                Songs are mastered near full scale. 12 puts their peaks at
                the standard ring's level; raise it for louder songs.
    endmenu
    menu "Answering machine"
        config DIGITS_VOICEMAIL
            bool "Answering machine on the SD card"
            depends on DIGITS_WEBRTC
            default y
            help
                Answers calls the server's per-line voicemail setting asks
                for, after its ring timeout. Messages are Ogg Opus files in
                voicemail/new and voicemail/saved on the card. Without a
                card the phone just keeps ringing, as before.
        config DIGITS_VOICEMAIL_MAX_MESSAGES
            int "Messages kept on the card"
            depends on DIGITS_VOICEMAIL
            range 1 1000
            default 50
            help
                A new message beyond this removes the oldest heard one, or
                the oldest unheard one if none was heard. 50 matches the Pi.
        config DIGITS_VOICEMAIL_MAX_SECONDS
            int "Longest message (seconds)"
            depends on DIGITS_VOICEMAIL
            range 10 3600
            default 600
            help
                The machine hangs up when a message reaches this length.
                600 matches the Pi. About 4 KB per second at 32 kbit/s.
        config DIGITS_VOICEMAIL_GREETING_LEVEL
            int "SD card greeting level (percent of the file's level)"
            range 1 100
            default 100
            help
                Level of voicemail/greeting.mp3 as sent to the caller.
    endmenu
    config DIGITS_SNTP_SERVER
        string "Time server (empty: no clock)"
        default "pool.ntp.org"
        help
            Sets the clock after Wi-Fi connects, for message dates on
            the SD card.
    config DIGITS_TIMEZONE
        string "Time zone (POSIX TZ)"
        default "CET-1CEST,M3.5.0,M10.5.0/3"
        help
            File dates on a FAT card are local time. The default is
            Central European time with daylight saving.
    menu "Onboard microphone"
        choice DIGITS_MIC_RECORD_MODE
            prompt "Microphone record/playback diagnostic"
            depends on SPIRAM && SPIRAM_MODE_OCT && (SPIRAM_USE_CAPS_ALLOC || SPIRAM_USE_MALLOC)
            default DIGITS_MIC_RECORD_DISABLED
        config DIGITS_MIC_RECORD_DISABLED
            bool "Disabled"
        config DIGITS_MIC_RECORD_PLAYBACK
            bool "Run a 2-second record-then-playback test once after boot"
            help
                Records two seconds five seconds after boot, mutes microphone
                capture, then plays saved audio with bounded digital gain.
                Output PCM peaks stay within the Ring Test's 8192 ceiling.
                Requires Octal PSRAM enabled under Component config -> ESP
                PSRAM. Reboot to repeat. No continuous loopback is enabled.
        config DIGITS_MIC_BUTTON_RECORD_PLAYBACK
            bool "Hold KEY1 to record; release to play (maximum 10 seconds)"
            help
                Uses the onboard KEY1 button through TCA9555 P11. Records
                signed 16-bit mono PCM in Octal PSRAM while held, then mutes
                ADC input and plays the saved recording with bounded digital
                gain. Output PCM peaks stay within the Ring Test's 8192 ceiling.
                At ten seconds recording stops and waits for release. Requires
                a fresh press each time; keys held at boot are ignored until
                released. BOOT and RESET retain their hardware functions.
        endchoice
        config DIGITS_MIC_DIAGNOSTIC
            bool "Enable microphone level diagnostic at boot"
            default n
            help
                Log RMS, peak and level meters for both onboard microphones and
                mono output about once per second. No raw PCM is printed.
                This changes logging only; capture and signaling keep running.
        config DIGITS_MIC_GAIN_DB
            int "ES7210 microphone gain (dB)"
            range 0 36
            default 24
            help
                Prefer multiples of 3 dB (the ADC gain step). 24 dB is a
                conservative starting point. Reduce if clipping is reported.
        choice DIGITS_MIC_MONO_SLOT
            prompt "Microphone channel for mono PCM"
            default DIGITS_MIC_MONO_LEFT
            config DIGITS_MIC_MONO_LEFT
                bool "MIC1 (left I2S slot)"
            config DIGITS_MIC_MONO_RIGHT
                bool "MIC2 (right I2S slot)"
            config DIGITS_MIC_MONO_AVERAGE
                bool "Average MIC1 and MIC2"
        endchoice
    endmenu
endmenu
```
